## meta-xilinx-bsp/conf/machine/qemumicroblazeel.conf
```bitbake
#@TYPE: Machine
#@NAME: qemumicroblazeel
#@DESCRIPTION: MicroBlaze QEMU virt machine support

require conf/machine/include/tune-microblaze.inc
require conf/machine/include/machine-xilinx-default.inc
require conf/machine/include/machine-xilinx-qemu.inc

TUNE_FEATURES_tune-microblaze += "v9.6 barrel-shift reorder pattern-compare divide-hard multiply-high fpu-hard"

MACHINE_FEATURES = ""

USE_VT = ""
SERIAL_CONSOLE = "115200 ttyS0"

KERNEL_IMAGETYPE ?= "linux.bin.ub"

# Use the networking setup from qemuarm
FILESOVERRIDES_append_pn-init-ifupdown = ":qemuarm"

# This machine is a targeting a QEMU model, runqemu setup:
IMAGE_CLASSES += "qemuboot"
QB_MEM = "-m 1024"
QB_MACHINE = "-machine virt"
QB_OPT_APPEND = "-nographic"
#QB_NETWORK_DEVICE = "-net nic,netdev=net0,macaddr=@MAC@"
```
